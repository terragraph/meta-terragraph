## conf/layer.conf
```bitbake
# We have a conf and classes directory, append to BBPATH
BBPATH .= ":${LAYERDIR}"

# Pick up a Facebook specific site.conf that defines
# variables only useful within facebook
# such as where the SSTATE cache is located.
BBPATH .= ":${LAYERDIR}/facebook"

# recipes can find top level directory with this yocto var
META_TERRAGRAPH_DIR := "${LAYERDIR}"

# We have a recipes directory, add to BBFILES
BBFILES += "${LAYERDIR}/recipes*/*/*.bb ${LAYERDIR}/recipes*/*/*.bbappend"

BBFILE_COLLECTIONS += "meta-terragraph"
BBFILE_PATTERN_meta-terragraph := "^${LAYERDIR}/"
BBFILE_PRIORITY_meta-terragraph = "7"

LICENSE_PATH += "${LAYERDIR}/licenses"

# Do not install 'recommended' glibc debug symbols and sources
BAD_RECOMMENDATIONS = "${TCLIBC}-dbg"

# give recipes a pointer to toplevel terragraph dir
META_TERRAGRAPH_DIR := "${LAYERDIR}"

LAYERSERIES_CORENAMES = "dunfell gatesgarth"
LAYERSERIES_COMPAT_meta-terragraph = "dunfell gatesgarth"

INHERIT += "qa-cmake-exports-workdir"
```

## meta-qca/conf/layer.conf
```bitbake
# We have a conf and classes directory, add to BBPATH
BBPATH .= ":${LAYERDIR}"

# We have recipes-* directories, add to BBFILES
BBFILES += "${LAYERDIR}/recipes-*/*/*.bb \
            ${LAYERDIR}/recipes-*/*/*.bbappend"

BBFILE_COLLECTIONS += "meta-qca"
BBFILE_PATTERN_meta-qca = "^${LAYERDIR}/"
BBFILE_PRIORITY_meta-qca = "10"

LAYERSERIES_CORENAMES = "dunfell gatesgarth"
LAYERSERIES_COMPAT_meta-qca = "dunfell gatesgarth"

# Hacky, but this gets variables undefined in TG modules
TG_ENABLE_DPAA2_forcevariable_pn-kernel-module-terragraph-dhd = "n"
TG_ENABLE_PFE_forcevariable_pn-kernel-module-terragraph-dhd = "n"
DEPENDS_remove_pn-kernel-module-terragraph-dhd = "nsp-headers"

TG_ENABLE_DPAA2_forcevariable_pn-kernel-module-terragraph-qca = "n"
TG_ENABLE_PFE_forcevariable_pn-kernel-module-terragraph-qca = "n"
DEPENDS_remove_pn-kernel-module-terragraph-qca = "nsp-headers"
```

## meta-qca/conf/local.conf.sample
```bitbake
#
# Local configuration file for building the Terragraph image.
#

# Set the VENDOR_ID variable to brand the resulting image.  For
# instance "Facebook ", "Foo Co ", etc.  This string will show up in
# the build version information as "Facebook Terragraph" or "Foo Co Terragraph".
# The string requires a trailing space as it will be prepended to "Terragraph".
# It is blank by default.
VENDOR_ID ?= ""

# Always look for packages first in our own local package mirror
SOURCE_MIRROR_URL ?= "file://${COREBASE}/../source_mirrors/"
INHERIT += "own-mirrors"

# Parallelism Options
#
# How many tasks bitbake should run in parallel:
BB_NUMBER_THREADS ?= "${@oe.utils.cpu_count()}"
# How many processes make should run in parallel:
PARALLEL_MAKE ?= "-j ${@oe.utils.cpu_count()}"

# Machine Selection
# When targeting NXP LS1012ARDB board
#MACHINE ??= "ls1012ardb"
# When targeting new FB CN board, use
MACHINE ??= "qoriq"

#
# Default policy config
# We could eventually create our own distro config if desired,
# but for now we use the standard poky distro settings.
#
DISTRO ?= "poky"

# Use IPK packages
PACKAGE_CLASSES ?= "package_ipk"
OPKGBUILDCMD = "opkg-build -Z gzip -a '-n1'"

# Don't build x11 for headless system
DISTRO_FEATURES_remove = " x11 wayland bluetooth"

# Extra image features.
# Currently we do not enable anything extra here.
#EXTRA_IMAGE_FEATURES = ""

# Avoid using these licenses when possible.
INCOMPATIBLE_LICENSE = "AGPL-3.0"

# Add centos-8 to the list of supported distributions.
SANITY_TESTED_DISTROS_append ?= " centos-8 \n"

#
# Additional image features
#
# The following is a list of additional classes to use when building images which
# enable extra features. Some available options which can be included in this variable
# are:
#   - 'buildstats' collect build statistics
#   - 'image-mklibs' to reduce shared library files size for an image
#   - 'image-prelink' in order to prelink the filesystem image
#   - 'image-swab' to perform host system intrusion detection
# NOTE: if listing mklibs & prelink both, then make sure mklibs is before prelink
# NOTE: mklibs also needs to be explicitly enabled for a given image, see local.conf.extended
USER_CLASSES ?= "buildstats image-mklibs image-prelink"

#
# Interactive shell configuration
#
# Under certain circumstances the system may need input from you and to do this it
# can launch an interactive shell. It needs to do this since the build is
# multithreaded and needs to be able to handle the case where more than one parallel
# process may require the user's attention. The default is iterate over the available
# terminal types to find one that works.
#
# Examples of the occasions this may happen are when resolving patches which cannot
# be applied, to use the devshell or the kernel menuconfig
#
# Supported values are auto, gnome, xfce, rxvt, screen, konsole (KDE 3.x only), none
# Note: currently, Konsole support only works for KDE 3.x due to the way
# newer Konsole versions behave
#OE_TERMINAL = "auto"
# By default disable interactive patch resolution (tasks will just fail instead):
PATCHRESOLVE = "noop"

#
# Disk Space Monitoring during the build
#
# Monitor the disk space during the build. If there is less that 1GB of space or less
# than 100K inodes in any key build location (TMPDIR, DL_DIR, SSTATE_DIR), gracefully
# shutdown the build. If there is less that 100MB or 1K inodes, perform a hard abort
# of the build. The reason for this is that running completely out of space can corrupt
# files and damages the build in ways which may not be easily recoverable.
BB_DISKMON_DIRS = "\
    STOPTASKS,${TMPDIR},1G,100K \
    STOPTASKS,${DL_DIR},1G,100K \
    STOPTASKS,${SSTATE_DIR},1G,100K \
    ABORT,${TMPDIR},100M,1K \
    ABORT,${DL_DIR},100M,1K \
    ABORT,${SSTATE_DIR},100M,1K"

#
# Shared-state files from other locations
#
# As mentioned above, shared state files are prebuilt cache data objects which can
# used to accelerate build time. This variable can be used to configure the system
# to search other mirror locations for these objects before it builds the data itself.
#
# This can be a filesystem directory, or a remote url such as http or ftp. These
# would contain the sstate-cache results from previous builds (possibly from other
# machines). This variable works like fetcher MIRRORS/PREMIRRORS and points to the
# cache locations to check for the shared objects.
# NOTE: if the mirror uses the same structure as SSTATE_DIR, you need to add PATH
# at the end as shown in the examples below. This will be substituted with the
# correct path within the directory structure.
SSTATE_MIRRORS ?= "\
file://.* file:///data/users/tg/terragraph.sstatecache.qca/LAST/qca/PATH"

# CONF_VERSION is increased each time build/conf/ changes incompatibly and is used to
# track the version of this file when it was generated. This can safely be ignored if
# this doesn't mean anything to you.
CONF_VERSION = "1"

# Update root password to 'facebook' and change the root shell back to bash.
# Also add a debugging user for techsupport that has no access to PII + Cert Only Auth
INHERIT += "extrausers"

EXTRA_USERS_PARAMS = " \
  usermod -s /bin/bash root; \
  usermod -p '\$1\$twb9FeH.\$eIuyZ9BujtTjqh73Qeqpr0' root; \
  useradd -c 'Support Account' -d /home/techsupport -g 100 -m -N -s /bin/bash techsupport; \
  "
ENABLE_ASAN = "0"
export ENABLE_ASAN

# Compile the QTI firmware from QTI/FB firmware sources and driver libraries
#PREFERRED_PROVIDER_virtual/wigig-fw-bin = "wigig-tg-src-lib-bin"

# Compile the QTI firmware from source using restricted libraries.
#PREFERRED_PROVIDER_virtual/wigig-fw-bin = "wigig-fw-bin"

# Compile the QTI firmware from source using restricted libraries from GES (QTI ADC).
#PREFERRED_PROVIDER_virtual/wigig-fw-bin = "wigig-fw-bin-ges"

# Use the January 20 2022 DPDK-OEMR2-CSU4 OEM QTI firmware release.
PREFERRED_PROVIDER_virtual/wigig-fw-bin = "wigig-fw-release-bin"
PREFERRED_VERSION_wireless-fw-interface = "44.21"
PREFERRED_VERSION_wigig-fw-release-bin = "44.21"
PREFERRED_VERSION_wigig-utils = "44.21"

# Use the June 29 2021 DPDK-OEMR2-CSU3 OEM QTI firmware release.
#PREFERRED_PROVIDER_virtual/wigig-fw-bin = "wigig-fw-release-bin"
#PREFERRED_VERSION_wireless-fw-interface = "44.20"
#PREFERRED_VERSION_wigig-fw-release-bin = "44.20"
#PREFERRED_VERSION_wigig-utils = "44.20"
#PREFERRED_VERSION_wigig-dpdk = "0.pre44.21"
```

## meta-qoriq/conf/layer.conf
```bitbake
# We have a conf and classes directory, append to BBPATH
BBPATH .= ":${LAYERDIR}"

# We have a recipes directory, add to BBFILES
BBFILES += "${LAYERDIR}/recipes*/*/*.bb ${LAYERDIR}/recipes*/*/*.bbappend"

BBFILE_COLLECTIONS += "meta-qoriq"
BBFILE_PATTERN_meta-qoriq := "^${LAYERDIR}/"
BBFILE_PRIORITY_meta-qoriq = "10"

LICENSE_PATH += "${LAYERDIR}/licenses"

EXTRA_IMAGE_FEATURES += "read-only-rootfs"

ROOT_HOME = "/data/root"

LAYERSERIES_CORENAMES = "dunfell gatesgarth"
LAYERSERIES_COMPAT_meta-qoriq = "dunfell gatesgarth"
```

## meta-qoriq/conf/machine/include/qoriq.inc
```bitbake
SOC_FAMILY = "fsl-lsch2"
require conf/machine/include/qoriq-base.inc
require conf/machine/include/arm/arch-arm64.inc

#PREFERRED_PROVIDER_virtual/bootloader = "u-boot"
KERNEL_IMAGETYPE = "fitImage"
KERNEL_CLASSES += "kernel-arm64-fitimage"
MACHINE_EXTRA_RRECOMMENDS = ""

EXTRA_IMAGEDEPENDS += "u-boot"

MACHINEOVERRIDES .= ":qoriq-arm64"
MACHINEOVERRIDES .= ":ls1012a"
MACHINEOVERRIDES .= ":ls1088a"
MACHINEOVERRIDES .= ":ls1012atg"
MACHINEOVERRIDES .= ":ls1012ardb"
MACHINEOVERRIDES .= ":ls1088ardb"
MACHINEOVERRIDES .= ":ls1048atg"
MACHINEOVERRIDES .= ":fb-ls1048a-puma"
MACHINEOVERRIDES .= ":fb-ls1048a-puma2"
MACHINEOVERRIDES .= ":fb-ls1048a-mbh"

UBOOT_LOADADDRESS = "0x80080000"
UBOOT_ENTRYPOINT = "0x80080000"
```

## meta-qoriq/conf/machine/qoriq.conf
```bitbake
#@TYPE: Machine
#@NAME: Facebook QorIQ-based boards
#@DESCRIPTION: Machine configuration for Terragraph boards

require conf/machine/include/qoriq.inc

USE_VT = "0"
SERIAL_CONSOLE = "115200 ttyS0"

MACHINE_EXTRA_RRECOMMENDS = "kernel-modules"
MACHINE_FEATURES = "wifi ext2 vfat"

PREFERRED_PROVIDER_virtual/aiop-fw ??= "aiop-fw-bin"

PREFERRED_PROVIDER_virtual/kernel = "linux-terragraph"
PREFERRED_VERSION_linux-terragraph = "4.14"

KERNEL_DEVICETREE ?= "freescale/fsl-ls1012a-tg.dtb freescale/fsl-ls1048a-tg.dtb \
    freescale/fsl-ls1088a-rdb.dtb freescale/fsl-ls1012a-rdb.dtb \
    freescale/fb-ls1048a-puma.dtb freescale/fb-ls1048a-puma-proto2.dtb \
    freescale/fb-ls1048a-mbh.dtb \
    "

KERNEL_DEFCONFIG ?= "${S}/arch/arm64/configs/defconfig"

UBOOT_CONFIG ??= "ls1012atg ls1048atg ls1012ardb ls1088ardb fb-ls1048a-puma \
    fb-ls1048a-puma2 fb-ls1048a-mbh \
    "

UBOOT_CONFIG[ls1012atg] = "ls1012atg_qspi_defconfig"
UBOOT_CONFIG[ls1048atg] = "ls1048atg_qspi_defconfig"
UBOOT_CONFIG[fb-ls1048a-puma] = "fb-ls1048a-puma_qspi_defconfig"
UBOOT_CONFIG[fb-ls1048a-puma2] = "fb-ls1048a-puma2_qspi_defconfig"
UBOOT_CONFIG[fb-ls1048a-mbh] = "fb-ls1048a-mbh_qspi_defconfig"
UBOOT_CONFIG[ls1088ardb] = "ls1088ardb_sdcard_qspi_defconfig"
UBOOT_CONFIG[ls1012ardb] = "ls1012ardb_qspi_defconfig"

MACHINE_ESSENTIAL_EXTRA_RDEPENDS += " \
    kernel-devicetree \
    kernel-module-terragraph-dhd \
    kernel-module-direct-vpp \
    kernel-module-qdisc \
    kernel-module-ip6table-filter \
    kernel-module-ip6-tables \
    "

MACHINE_ESSENTIAL_EXTRA_RRECOMMENDS += "kernel-modules"

IMAGE_INSTALL_append = " restool"
IMAGE_INSTALL_append = " kexec-tools"
IMAGE_INSTALL_append = " makedumpfile"
IMAGE_INSTALL_append = " kernel-kdump-image-image"
IMAGE_INSTALL_append = " dtc"
IMAGE_INSTALL_append = " linuxptp"

#  kernel-module-tcp-probe \
#

EXTRA_IMAGEDEPENDS += "atf ppa rcw mc-utils management-complex"
```

## meta-x86/conf/layer.conf
```bitbake
# We have a conf and classes directory, append to BBPATH
BBPATH .= ":${LAYERDIR}"

# We have a recipes directory, add to BBFILES
BBFILES += "${LAYERDIR}/recipes*/*/*.bb ${LAYERDIR}/recipes*/*/*.bbappend"

BBFILE_COLLECTIONS += "meta-x86"
BBFILE_PATTERN_meta-x86 := "^${LAYERDIR}/"
BBFILE_PRIORITY_meta-x86 = "10"

LAYERSERIES_CORENAMES = "dunfell gatesgarth"
LAYERSERIES_COMPAT_meta-x86 = "dunfell gatesgarth"
```

## meta-x86/conf/machine/tgx86.conf
```bitbake
#@TYPE: Machine
#@NAME: x86-64 based on qemux86-64
#@DESCRIPTION: Machine configuration for running a common x86

DEFAULTTUNE ?= "core2-64"
require conf/machine/include/tune-core2.inc

SERIAL_CONSOLE = "115200 ttyS0"

MACHINE_FEATURES += "x86"

PREFERRED_PROVIDER_virtual/kernel = "linux-dummy"
```
